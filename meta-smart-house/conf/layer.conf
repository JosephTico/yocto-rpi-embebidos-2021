## meta-smart-house/conf/layer.conf
```bitbake
# We have a conf and classes directory, add to BBPATH
BBPATH .= ":${LAYERDIR}"

# We have recipes-* directories, add to BBFILES
BBFILES += "${LAYERDIR}/recipes-*/*/*.bb \
            ${LAYERDIR}/recipes-*/*/*.bbappend"

BBFILE_COLLECTIONS += "smart-house"
BBFILE_PATTERN_smart-house = "^${LAYERDIR}/"
BBFILE_PRIORITY_smart-house = "6"

LAYERDEPENDS_smart-house = "core"
LAYERSERIES_COMPAT_smart-house = "hardknott"

IMAGE_INSTALL_append = " nodejs nodejs-npm express house-web-client gd v4l-utils fswebcam gpio-sensor"
```

## rpi2/conf/bblayers.conf
```bitbake
# POKY_BBLAYERS_CONF_VERSION is increased each time build/conf/bblayers.conf
# changes incompatibly
POKY_BBLAYERS_CONF_VERSION = "2"

BBPATH = "${TOPDIR}"
BBFILES ?= ""

BBLAYERS ?= " \
  /home/joseph/tec/yocto/meta \
  /home/joseph/tec/yocto/meta-poky \
  /home/joseph/tec/yocto/meta-yocto-bsp \
  /home/joseph/tec/yocto/meta-raspberrypi \
  /home/joseph/tec/yocto/meta-smart-house \
  /home/joseph/tec/yocto/meta-openembedded/meta-oe \
  "
```
